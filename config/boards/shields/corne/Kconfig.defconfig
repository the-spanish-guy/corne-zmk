## config/boards/shields/corne/Kconfig.defconfig
```kconfig
if SHIELD_CORNE_LEFT

config ZMK_KEYBOARD_NAME
	default "Corne"

config ZMK_SPLIT_BLE_ROLE_CENTRAL
	default y

endif

if SHIELD_CORNE_LEFT || SHIELD_CORNE_RIGHT

config ZMK_SPLIT
	default y

endif

if SHIELD_CORNE_LEFT || SHIELD_CORNE_RIGHT

config ZMK_KEYBOARD_NAME
	default "Corne"

if ZMK_DISPLAY

config I2C
	default y

config SSD1306
	default y

if SSD1306

config SSD1306_REVERSE_MODE
	default y

endif # SSD1306

if LVGL_VDB_SIZE

config LVGL_VDB_SIZE
	default 64

endif # LVGL_VDB_SIZE

if LVGL_DPI

config LVGL_DPI
	default 148

endif # LVGL_DPI

if LVGL_BUF_SIZE

config LVGL_BUF_SIZE
	default 32

endif # LVGL_BUF_SIZE

endif # ZMK_DISPLAY

if ZMK_RGB_UNDERGLOW

config SPI
	default y

config WS2812_STRIP
	default y

endif # ZMK_RGB_UNDERGLOW

endif # SHIELD_CORNE_LEFT || SHIELD_CORNE_RIGHT
```

## config/west.yml
```yaml
manifest:
  remotes:
    - name: zmkfirmware
      url-base: https://github.com/zmkfirmware
    - name: petejohanson
      url-base: https://github.com/petejohanson
    - name: tokyo2006
      url-base: https://github.com/tokyo2006
    - name: kevinpastor
      url-base: https://github.com/kevinpastor
    - name: m165437
      url-base: https://github.com/M165437
    - name: s6t
      url-base: https://github.com/s6t
    - name: infely
      url-base: https://github.com/infely
  projects:
    - name: zmk
      remote: zmkfirmware
      revision: main
      import: app/west.yml
    - name: zmk-nice-oled
      remote: tokyo2006
      revision: 60b9a3aa1b15a51813efec14cc2c4a8ddd7beafe
    - name: nice-view-elemental
      remote: kevinpastor
      revision: main
    - name: nice-view-gem
      remote: m165437
      revision: main
    - name: zmk-shield-nice-view-cats
      remote: s6t
      revision: main
    - name: nice-view-battery
      remote: infely
      revision: main
  self:
    path: config
```
